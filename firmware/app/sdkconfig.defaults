## firmware/app/sdkconfig.defaults
```kconfig
CONFIG_COMPILER_OPTIMIZATION_SIZE=y
CONFIG_ESP_MAIN_TASK_STACK_SIZE=8192
CONFIG_PARTITION_TABLE_CUSTOM=y
CONFIG_MBEDTLS_CERTIFICATE_BUNDLE=y
CONFIG_MBEDTLS_PEM_WRITE_C=y
CONFIG_MBEDTLS_X509_CSR_WRITE_C=y
CONFIG_MBEDTLS_X509_CRT_PARSE_C=y
CONFIG_MQTT_TRANSPORT_SSL=y
```

## firmware/board/espressif/esp-mosaico/native/project/sdkconfig.defaults
```kconfig
CONFIG_ESP_COREDUMP_ENABLE_TO_NONE=y
CONFIG_PARTITION_TABLE_CUSTOM=y
CONFIG_PARTITION_TABLE_CUSTOM_FILENAME="../../layout/partitions.csv"
CONFIG_ESPTOOLPY_FLASHSIZE_16MB=y
CONFIG_ESP_MAIN_TASK_STACK_SIZE=20480
CONFIG_FREERTOS_USE_TICKLESS_IDLE=n
CONFIG_BSP_CO5300_ENABLE_TE=n
CONFIG_MBEDTLS_CERTIFICATE_BUNDLE=y
CONFIG_MBEDTLS_PEM_WRITE_C=y
CONFIG_MBEDTLS_X509_CREATE_C=y
CONFIG_MBEDTLS_X509_CSR_WRITE_C=y
CONFIG_SPIRAM=y
CONFIG_SPIRAM_SPEED_250M=y
CONFIG_SPIRAM_XIP_FROM_PSRAM=y
CONFIG_SPIRAM_MEMTEST=n
CONFIG_LV_OS_FREERTOS=y
CONFIG_LV_USE_CLIB_MALLOC=y
CONFIG_LV_USE_CLIB_STRING=y
CONFIG_LV_USE_CLIB_SPRINTF=y
```

## firmware/board/m5stack/atoms3/examples/uiflow-bleuart-client/sdkconfig.defaults
```kconfig
CONFIG_BT_ENABLED=y
CONFIG_BT_NIMBLE_ENABLED=y
CONFIG_BT_NIMBLE_ROLE_CENTRAL=y
CONFIG_BT_NIMBLE_ROLE_OBSERVER=y
CONFIG_BT_NIMBLE_ROLE_PERIPHERAL=n
CONFIG_BT_NIMBLE_ROLE_BROADCASTER=n
CONFIG_BT_NIMBLE_MAX_CONNECTIONS=1
CONFIG_BT_NIMBLE_MAX_BONDS=0
CONFIG_BT_NIMBLE_SECURITY_ENABLE=n
CONFIG_ESP_COEX_SW_COEXIST_ENABLE=y
```

## firmware/board/m5stack/paper-color/examples/factory-demo/sdkconfig.defaults
```kconfig
CONFIG_ESP_DEFAULT_CPU_FREQ_MHZ_160=y
CONFIG_ESP_MAIN_TASK_STACK_SIZE=10240
CONFIG_ESP_CONSOLE_UART_CUSTOM=y
CONFIG_ESP_CONSOLE_SECONDARY_USB_SERIAL_JTAG=y
CONFIG_ESP_CONSOLE_UART_TX_GPIO=5
CONFIG_ESP_CONSOLE_UART_RX_GPIO=4
CONFIG_ESP_CONSOLE_UART_BAUDRATE=115200
CONFIG_ESP_BROWNOUT_DET=y
CONFIG_ESP_BROWNOUT_DET_LVL_SEL_7=y
CONFIG_ESP_WIFI_ENABLED=y
CONFIG_ESP_WIFI_ENABLE_WPA3_SAE=y
CONFIG_ESP_WIFI_ENABLE_SAE_PK=y
CONFIG_ESP_WIFI_ENABLE_SAE_H2E=y
CONFIG_ESP_WIFI_SOFTAP_SAE_SUPPORT=y
CONFIG_ESP_WIFI_ENABLE_WPA3_OWE_STA=y
CONFIG_ESP_WIFI_ENTERPRISE_SUPPORT=y
CONFIG_FATFS_VOLUME_COUNT=2
CONFIG_FATFS_LFN_HEAP=y
CONFIG_FATFS_SECTOR_4096=y
CONFIG_FATFS_CODEPAGE_437=y
CONFIG_FATFS_MAX_LFN=255
CONFIG_FATFS_PER_FILE_CACHE=y
CONFIG_FATFS_ALLOC_PREFER_EXTRAM=y
CONFIG_SPIFFS_MAX_PARTITIONS=3
CONFIG_SPIFFS_PAGE_SIZE=256
CONFIG_SPIFFS_USE_MAGIC=y
CONFIG_SPIFFS_USE_MAGIC_LENGTH=y
CONFIG_SPIFFS_META_LENGTH=4
CONFIG_SPIFFS_USE_MTIME=y
CONFIG_WL_SECTOR_SIZE_4096=y
CONFIG_TINYUSB_MSC_ENABLED=y
CONFIG_TINYUSB_MSC_BUFSIZE=4096
CONFIG_TINYUSB_MSC_MOUNT_PATH="/data"
CONFIG_TINYUSB_SUSPEND_CALLBACK=y
CONFIG_TINYUSB_RESUME_CALLBACK=y
CONFIG_I2C_BUS_DYNAMIC_CONFIG=y
CONFIG_I2C_MS_TO_WAIT=200
CONFIG_MDNS_MULTIPLE_INSTANCE=y
CONFIG_MDNS_ENABLE_CONSOLE_CLI=y
CONFIG_LWIP_MAX_SOCKETS=16
```

## firmware/board/waveshare/esp32-s3-lcd-5/examples/display-color-bars/sdkconfig.defaults
```kconfig
CONFIG_COMPILER_CXX_EXCEPTIONS=y
CONFIG_ESP_PANEL_BOARD_DEFAULT_USE_SUPPORTED=y
CONFIG_ESP_PANEL_BOARD_MANUFACTURER_WAVESHARE=y
CONFIG_BOARD_WAVESHARE_ESP32_S3_TOUCH_LCD_5=y
```

## firmware/bootloader/common/main/Kconfig.projbuild
```kconfig
menu "esp-bootloader"

    config EH_URL_OTA
        bool
        default y

endmenu
```

## firmware/bootloader/esp32-16mb/sdkconfig.defaults
```kconfig
CONFIG_ESPTOOLPY_FLASHSIZE_16MB=y
CONFIG_OKOU_BL_PROFILE="esp32-16mb"
CONFIG_ESP_CONSOLE_UART_DEFAULT=y
```

## firmware/bootloader/esp32-8mb/sdkconfig.defaults
```kconfig
CONFIG_ESPTOOLPY_FLASHSIZE_8MB=y
CONFIG_OKOU_BL_PROFILE="esp32-8mb"
CONFIG_PARTITION_TABLE_CUSTOM_FILENAME="../../partitions/8mb.csv"
CONFIG_ESP_CONSOLE_UART_DEFAULT=y
```

## firmware/bootloader/esp32c6-16mb/sdkconfig.defaults
```kconfig
CONFIG_ESPTOOLPY_FLASHSIZE_16MB=y
CONFIG_EH_BL_PROFILE="esp32c6-16mb"

CONFIG_COMPILER_OPTIMIZATION_ASSERTIONS_SILENT=y
```

## firmware/bootloader/esp32c61-16mb/sdkconfig.defaults
```kconfig
CONFIG_ESPTOOLPY_FLASHSIZE_16MB=y
CONFIG_EH_BL_PROFILE="esp32c61-16mb"

CONFIG_COMPILER_OPTIMIZATION_ASSERTIONS_SILENT=y
CONFIG_LOG_DEFAULT_LEVEL_WARN=y
```

## firmware/bootloader/esp32s3-16mb-uart/sdkconfig.defaults
```kconfig
CONFIG_ESPTOOLPY_FLASHSIZE_16MB=y
CONFIG_EH_BL_PROFILE="esp32s3-16mb-uart"
CONFIG_ESP_CONSOLE_UART_DEFAULT=y
```

## firmware/bootloader/esp32s3-32mb-uart/sdkconfig.defaults
```kconfig
CONFIG_ESPTOOLPY_FLASHSIZE_32MB=y
CONFIG_EH_BL_PROFILE="esp32s3-32mb-uart"
CONFIG_PARTITION_TABLE_CUSTOM_FILENAME="../../partitions/32mb.csv"
CONFIG_ESP_CONSOLE_UART_DEFAULT=y
```

## firmware/bootloader/esp32s3-32mb/sdkconfig.defaults
```kconfig
CONFIG_ESPTOOLPY_FLASHSIZE_32MB=y
CONFIG_OKOU_BL_PROFILE="esp32s3-32mb"
CONFIG_PARTITION_TABLE_CUSTOM_FILENAME="../../partitions/32mb.csv"
```

## firmware/bootloader/esp32s3-8mb-uart/sdkconfig.defaults
```kconfig
CONFIG_ESPTOOLPY_FLASHSIZE_8MB=y
CONFIG_EH_BL_PROFILE="esp32s3-8mb-uart"
CONFIG_PARTITION_TABLE_CUSTOM_FILENAME="../../partitions/8mb.csv"
CONFIG_ESP_CONSOLE_UART_DEFAULT=y
```

## firmware/bootloader/esp32s3-8mb/sdkconfig.defaults
```kconfig
CONFIG_ESPTOOLPY_FLASHSIZE_8MB=y
CONFIG_OKOU_BL_PROFILE="esp32s3-8mb"
CONFIG_PARTITION_TABLE_CUSTOM_FILENAME="../../partitions/8mb.csv"
```

## firmware/components/eh_agent/Kconfig
```kconfig
menu "EspHub agent (esp-bootloader SDK)"

    config EH_LAUNCHER
        bool "Build the EspHub Launcher"
        default n
        help
            Set only by the EspHub Launcher project. Enables its OTA, provisioning and BLE
            paths in the SDK. Applications leave it off.

    config EH_BL_PROFILE
        string "Compatible EspHub bootloader variant"
        default ""

    config EH_NET_OPENETH
        bool "Use OpenCores Ethernet (QEMU) instead of Wi-Fi"
        depends on ETH_USE_OPENETH
        default n
        help
            For Espressif QEMU builds (-nic user,model=open_eth). Wi-Fi is not initialised.

    config EH_MAX_CMDS
        int "Max registered commands"
        default 24

    config EH_CMD_OUT_MAX
        int "Max command output (bytes)"
        range 256 12288
        default 4096

    config EH_TASK_STACK
        int "Agent task stack size"
        default 6144

    config EH_TASK_PRIO
        int "Agent task priority (keep low)"
        default 2

    config EH_BLE_WIFI
        bool
        default y if EH_LAUNCHER && BT_NIMBLE_ENABLED && !EH_NET_OPENETH

endmenu
```

## firmware/components/okou_agent/Kconfig
```kconfig
menu "okou agent (esp-bootloader SDK)"

    config OKOU_BOARD_PROFILE
        string "Board profile reported by a board-specific application"
        default ""

    config OKOU_BL_PROFILE
        string "Compatible EspHub bootloader variant"
        default ""

    config OKOU_NET_OPENETH
        bool "Use OpenCores Ethernet (QEMU) instead of Wi-Fi"
        depends on ETH_USE_OPENETH
        default n
        help
            For Espressif QEMU builds (-nic user,model=open_eth). Wi-Fi is not initialised.

    config OKOU_QEMU_SYSTEM_RESET
        bool "QEMU workaround: make esp_restart() a full system reset"
        depends on OKOU_NET_OPENETH
        default y
        help
            Espressif QEMU does not reset peripherals on SW_CPU_RESET; the next boot then
            crashes in esp_timer_init. Only for QEMU builds.

    config OKOU_MAX_CMDS
        int "Max registered commands"
        default 24

    config OKOU_MAX_PARAMS
        int "Max registered params"
        default 24

    config OKOU_CMD_OUT_MAX
        int "Max command output (bytes)"
        range 256 12288
        default 4096

    config OKOU_TASK_STACK
        int "Agent task stack size"
        default 6144

    config OKOU_TASK_PRIO
        int "Agent task priority (keep low)"
        default 2

    config OKOU_MICROPYTHON_RUNTIME
        bool "ESP Hub MicroPython runtime"
        default n

    config OKOU_BLE_WIFI
        bool
        default y if BT_NIMBLE_ENABLED && !OKOU_NET_OPENETH

endmenu
```
