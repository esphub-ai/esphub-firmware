## tests/fixtures/agent-qemu/sdkconfig.defaults
```kconfig
CONFIG_FREERTOS_UNICORE=y
CONFIG_FREERTOS_HZ=1000
CONFIG_ESPTOOLPY_FLASHSIZE_4MB=y
CONFIG_ESP_CONSOLE_UART_DEFAULT=y
CONFIG_ESP_CONSOLE_SECONDARY_NONE=y
CONFIG_ESP_MAIN_TASK_STACK_SIZE=6144
CONFIG_ETH_USE_OPENETH=y
CONFIG_OKOU_NET_OPENETH=y
# CONFIG_OKOU_QEMU_SYSTEM_RESET is not set
# CONFIG_BT_ENABLED is not set
# CONFIG_ESP_TASK_WDT_EN is not set
CONFIG_LOG_COLORS=n
CONFIG_COMPILER_OPTIMIZATION_SIZE=y
```

## tests/fixtures/launcher-resize-qemu/sdkconfig.defaults
```kconfig
CONFIG_ESPTOOLPY_FLASHSIZE_8MB=y
CONFIG_PARTITION_TABLE_CUSTOM=y
CONFIG_PARTITION_TABLE_CUSTOM_FILENAME="../../../firmware/partitions/8mb.csv"
CONFIG_ESP_CONSOLE_UART_DEFAULT=y
CONFIG_ESP_MAIN_TASK_STACK_SIZE=8192
CONFIG_FREERTOS_UNICORE=y
CONFIG_COMPILER_OPTIMIZATION_SIZE=y
CONFIG_LOG_COLORS=n
```
